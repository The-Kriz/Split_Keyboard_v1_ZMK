## boards/shields/ArcSplit_46/Kconfig.defconfig
```kconfig
if SHIELD_ARCSPLIT_46_LEFT

# Name must be less than 16 characters long!
config ZMK_KEYBOARD_NAME
    default "Rolio46"

config ZMK_SPLIT_ROLE_CENTRAL
    default y

config ZMK_SPLIT_BLE_CENTRAL_PERIPHERALS
  default 1

config BT_MAX_CONN
  default 6

config BT_MAX_PAIRED
  default 6

endif

if SHIELD_ARCSPLIT_46_LEFT || SHIELD_ARCSPLIT_46_RIGHT

config ZMK_SPLIT
    default y

config ZMK_POINTING
    default y

endif


if BOARD_NICE_NANO && SHIELD_ARCSPLIT_46_RIGHT

config I2C
    default y

endif
```

## boards/shields/ArcSplit_46/Kconfig.shield
```kconfig
config SHIELD_ARCSPLIT_46_LEFT
    def_bool $(shields_list_contains,ArcSplit_46_left)
  
config SHIELD_ARCSPLIT_46_RIGHT
    def_bool $(shields_list_contains,ArcSplit_46_right)
  
```

## boards/shields/diy_keyboard_v1/Kconfig.defconfig
```kconfig
if SHIELD_DIY_KEYBOARD_V1_LEFT

# Name must be less than 16 characters long!
config ZMK_KEYBOARD_NAME
    default "DIY_Keyboard_V1"

config ZMK_SPLIT_ROLE_CENTRAL
    default y

config ZMK_SPLIT_BLE_CENTRAL_PERIPHERALS
  default 1

config BT_MAX_CONN
  default 6

config BT_MAX_PAIRED
  default 6

endif

if SHIELD_DIY_KEYBOARD_V1_LEFT || SHIELD_DIY_KEYBOARD_V1_RIGHT

config ZMK_SPLIT
    default y

config ZMK_POINTING
    default y

endif

# ---------------------
# Kconfig for shield "diy_keyboard_v1_right" with board "nice_nano_v2"
# ---------------------
if BOARD_NICE_NANO_V2 && SHIELD_DIY_KEYBOARD_V1_RIGHT

config I2C
    default y

endif
```

## boards/shields/diy_keyboard_v1/Kconfig.shield
```kconfig
config SHIELD_DIY_KEYBOARD_V1_LEFT
    def_bool $(shields_list_contains,diy_keyboard_v1_left)
  
config SHIELD_DIY_KEYBOARD_V1_RIGHT
    def_bool $(shields_list_contains,diy_keyboard_v1_right)
  
```
